## main/Kconfig.projbuild
```kconfig
menu "APC UPS Configuration"

    config PROVISIONING_AP_PREFIX
        string "Provisioning AP SSID prefix"
        default "APC-UPS-Setup"
        help
            The device appends the last 3 MAC bytes to this prefix when
            starting the first-boot provisioning access point.

    config PROVISIONING_AP_PASSWORD
        string "Provisioning AP password"
        default "configureme"
        help
            Temporary provisioning access point password. Must be empty for
            an open AP or at least 8 characters for WPA2-PSK.

    config UPS_POLL_INTERVAL_MS
        int "UPS Poll Interval (ms)"
        range 1000 60000
        default 5000

    config MQTT_PUBLISH_INTERVAL_MS
        int "MQTT Publish Interval (ms)"
        range 5000 300000
        default 60000

endmenu
```

## sdkconfig.defaults
```kconfig
CONFIG_IDF_TARGET="esp32s3"
CONFIG_ESPTOOLPY_FLASHSIZE_4MB=y
CONFIG_ESPTOOLPY_FLASHSIZE="4MB"
CONFIG_ESP_DEFAULT_CPU_FREQ_MHZ_160=y
CONFIG_USB_HOST_CONTROL_TRANSFER_MAX_SIZE=256
CONFIG_UPS_POLL_INTERVAL_MS=5000
CONFIG_MQTT_PUBLISH_INTERVAL_MS=10000
CONFIG_ESPTOOLPY_MONITOR_BAUD=115200
CONFIG_ESP_CONSOLE_UART_DEFAULT=y
# CONFIG_ESP_CONSOLE_USB_CDC is not set
# CONFIG_ESP_CONSOLE_USB_SERIAL_JTAG is not set
CONFIG_ESP_CONSOLE_UART=y
CONFIG_ESP_CONSOLE_UART_NUM=0
CONFIG_ESP_CONSOLE_UART_BAUDRATE=115200
```
